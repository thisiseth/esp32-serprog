## src/serprog/main/KConfig.projbuild
```kconfig
menu "esp32-serprog"
    
    choice ESP32_SERPROG_WIFI
        prompt "WiFi configuration"
        default ESP32_SERPROG_WIFI_DISABLED
        help
            Choose how the WiFi settings should be configured.

        config ESP32_SERPROG_WIFI_DISABLED
            bool
            prompt "WiFi disabled, UART is used for serprog"
        config ESP32_SERPROG_WIFI_ENABLED
            bool
            prompt "WiFi enabled, UART is used for log output"
    endchoice

    config ESP32_SERPROG_WIFI_SSID
        string "Connect to SSID name"
        depends on ESP32_SERPROG_WIFI_ENABLED
        default "your_ssid"
        
    config ESP32_SERPROG_WIFI_PASSWORD
        string "WiFi password"
        depends on ESP32_SERPROG_WIFI_ENABLED
        default "your_password"

    config ESP32_SERPROG_WIFI_HOSTNAME
        string "Device hostname"
        depends on ESP32_SERPROG_WIFI_ENABLED
        default "esp32-serprog"
    
    
    config ESP32_SERPROG_WIFI_TCP_PORT
        int "Listen on TCP port"
        depends on ESP32_SERPROG_WIFI_ENABLED
        default 8888
        
endmenu
```

## src/serprog/sdkconfig.defaults
```kconfig
CONFIG_UART_ISR_IN_IRAM=y
CONFIG_LWIP_CHECK_THREAD_SAFETY=y

CONFIG_COMPILER_OPTIMIZATION_PERF=y
```

## src/serprog/sdkconfig.defaults.esp32s3
```kconfig
# set usb_serial_jtag as primary to enable input

CONFIG_ESP_CONSOLE_USB_SERIAL_JTAG=y
CONFIG_ESP_CONSOLE_SECONDARY_NONE=y
CONFIG_ESP_CONSOLE_USB_SERIAL_JTAG_ENABLED=y
CONFIG_ESP_CONSOLE_MULTIPLE_UART=y
CONFIG_ESP_CONSOLE_UART_NUM=-1

CONFIG_LWIP_TCPIP_TASK_AFFINITY_CPU1=y
CONFIG_LWIP_TCPIP_TASK_AFFINITY=0x1
CONFIG_ESP_WIFI_TASK_PINNED_TO_CORE_1=y
```
